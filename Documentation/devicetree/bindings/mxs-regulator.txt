## Documentation/devicetree/bindings/mxs-regulator.txt
```
MXS regulators

Required node properties:
- compatible: Should be "fsl,<soc>-power", where soc is "imx23" or "imx28"
- reg: Offset and length of the register set for the device

Required regulator properties:
- compatible: Must be "fsl,mxs-regulator"
- reg: Offset of the register set for the regulator
- mxs-max-reg-val: Maximum value of this register

Optional regulator properties:
- mxs-default-microvolt: initial voltage of the regulator

Any regulator property defined as part of the core regulator
binding, defined in regulator.txt, can also be used.

Example:

	power: power@80044000 {
		compatible = "fsl,imx28-power";
		#address-cells = <1>;
		#size-cells = <0>;
		reg = <0x80044000 0x2000>;

		reg_vddio: regulator-vddio@80044060 {
			reg = <0x80044060>;
			compatible = "fsl,mxs-regulator";
			regulator-name = "vddio";
			regulator-min-microvolt = <2800000>;
			regulator-max-microvolt = <3600000>;
			regulator-microvolt-offset = <80000>;
			regulator-always-on;
			mxs-max-reg-val = <0x10>;
			mxs-default-microvolt = <3300000>;
		};
	};
```

## Documentation/devicetree/bindings/power/mxs_power.txt
```
Power subsystem for Freescale MX23/MX28

Required properties:
- compatible:
  - "fsl,imx23-power" for MX23
  - "fsl,imx23-vdda" for MX28
- address-cells: should be 1
- size-cells: should be 1
- reg: Address and length of the register set for the power subsystem.

Optional properties;
- interrupts: Interrupts used by the power subsystem

Example for imx28:

	power: power@80044000 {
				compatible = "fsl,imx28-power";
				#address-cells = <1>;
				#size-cells = <1>;
				reg = <0x80044000 0x2000>;
				interrupts = <6>;
				ranges;
	}
```

## Documentation/devicetree/bindings/regulator/mxs-regulator.txt
```
Regulators for Freescale MX233/MX28

Required properties:
- compatible:
  - "fsl,mxs-regulator-vddd" for VDDD
  - "fsl,mxs-regulator-vdda" for VDDA
  - "fsl,mxs-regulator-vddio" for VDDIO
- reg: Address and length of the register set for the device. It contains
  the information of registers in the same order as described by reg-names
- reg-names: Should contain the reg names
  - "base-address"	- contains base address of regulator
  - "status-address"	- contains status address of regulator

Any regulator property defined as part of the core regulator
binding, defined in regulator.txt, can also be used.

Example:

	reg_vddd: regulator@80044040 {
		reg = <0x80044040 0x10>, <0x800440c0 0x10>;
		reg-names = "base-address", "status-address";
		compatible = "fsl,mxs-regulator-vddd";
		regulator-name = "vddd";
		regulator-min-microvolt = <800000>;
		regulator-max-microvolt = <1575000>;
		regulator-boot-on;
		vddd-supply = <&reg_vdda>;
	};
```
